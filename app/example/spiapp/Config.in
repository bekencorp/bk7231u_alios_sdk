## app/example/spiapp/Config.in
```kconfig
config AOS_APP_SPIAPP
    bool "spi Application"
    select AOS_COMP_CLI
    select AOS_COMP_NETMGR
    select AOS_COMP_OTA
    select AOS_COMP_CJSON
    select AOS_COMP_LINKKIT_SDK_C
    select APP_FEATURE_LINKKIT
    help
        spiapp
```

## board/Config.in
```kconfig
menu "BSP         Configuration"
choice
    prompt "Board Selection"

source "board/bk7231udevkitc/Config.in"
if AOS_BOARD_BK7231U
    config AOS_BUILD_BOARD
        default "bk7231udevkitc"

    source "platform/mcu/bk7231u/Config.in"
    source "platform/arch/arm/armv5/Config.in"
endif

endchoice

endmenu
```
